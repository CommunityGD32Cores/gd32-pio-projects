/* ROM symbol list */ 
define exported symbol ED25519_verify = 0x0ff4f825; 
define exported symbol __exit = 0x0ff4f989; 
define exported symbol mbedtls_aes_crypt_cbc = 0x0ff56a25; 
define exported symbol mbedtls_aes_crypt_cfb128 = 0x0ff56a99; 
define exported symbol mbedtls_aes_crypt_cfb8 = 0x0ff56b21; 
define exported symbol mbedtls_aes_crypt_ctr = 0x0ff56b95; 
define exported symbol mbedtls_aes_crypt_ecb = 0x0ff56c11; 
define exported symbol mbedtls_aes_crypt_ofb = 0x0ff56c45; 
define exported symbol mbedtls_aes_free = 0x0ff56ca5; 
define exported symbol mbedtls_aes_init = 0x0ff56cb1; 
define exported symbol mbedtls_aes_setkey_dec = 0x0ff56cb9; 
define exported symbol mbedtls_aes_setkey_enc = 0x0ff56cc9; 
define exported symbol mbedtls_arc4_crypt = 0x0ff56cd9; 
define exported symbol mbedtls_arc4_free = 0x0ff56d25; 
define exported symbol mbedtls_arc4_init = 0x0ff56d35; 
define exported symbol mbedtls_arc4_setup = 0x0ff56d41; 
define exported symbol mbedtls_asn1_find_named_data = 0x0ff56d95; 
define exported symbol mbedtls_asn1_free_named_data = 0x0ff56dc5; 
define exported symbol mbedtls_asn1_free_named_data_list = 0x0ff56de9; 
define exported symbol mbedtls_asn1_get_alg = 0x0ff56e0d; 
define exported symbol mbedtls_asn1_get_alg_null = 0x0ff56ea1; 
define exported symbol mbedtls_asn1_get_bitstring = 0x0ff56ee9; 
define exported symbol mbedtls_asn1_get_bitstring_null = 0x0ff56f35; 
define exported symbol mbedtls_asn1_get_bool = 0x0ff56f69; 
define exported symbol mbedtls_asn1_get_int = 0x0ff56fa5; 
define exported symbol mbedtls_asn1_get_len = 0x0ff57009; 
define exported symbol mbedtls_asn1_get_mpi = 0x0ff570b5; 
define exported symbol mbedtls_asn1_get_sequence_of = 0x0ff570e1; 
define exported symbol mbedtls_asn1_get_tag = 0x0ff57165; 
define exported symbol mbedtls_asn1_store_named_data = 0x0ff57199; 
define exported symbol mbedtls_asn1_write_algorithm_identifier = 0x0ff57251; 
define exported symbol mbedtls_asn1_write_bitstring = 0x0ff572b1; 
define exported symbol mbedtls_asn1_write_bool = 0x0ff57345; 
define exported symbol mbedtls_asn1_write_ia5_string = 0x0ff57395; 
define exported symbol mbedtls_asn1_write_int = 0x0ff573ad; 
define exported symbol mbedtls_asn1_write_len = 0x0ff57421; 
define exported symbol mbedtls_asn1_write_mpi = 0x0ff57525; 
define exported symbol mbedtls_asn1_write_named_bitstring = 0x0ff575b5; 
define exported symbol mbedtls_asn1_write_null = 0x0ff57605; 
define exported symbol mbedtls_asn1_write_octet_string = 0x0ff5762d; 
define exported symbol mbedtls_asn1_write_oid = 0x0ff5766d; 
define exported symbol mbedtls_asn1_write_printable_string = 0x0ff576ad; 
define exported symbol mbedtls_asn1_write_raw_buffer = 0x0ff576c5; 
define exported symbol mbedtls_asn1_write_tag = 0x0ff576f1; 
define exported symbol mbedtls_asn1_write_tagged_string = 0x0ff5770d; 
define exported symbol mbedtls_asn1_write_utf8_string = 0x0ff5775d; 
define exported symbol mbedtls_base64_decode = 0x0ff57775; 
define exported symbol mbedtls_base64_encode = 0x0ff57911; 
define exported symbol mbedtls_blowfish_crypt_cbc = 0x0ff57a1d; 
define exported symbol mbedtls_blowfish_crypt_cfb64 = 0x0ff57ac1; 
define exported symbol mbedtls_blowfish_crypt_ctr = 0x0ff57b51; 
define exported symbol mbedtls_blowfish_crypt_ecb = 0x0ff57bd9; 
define exported symbol mbedtls_blowfish_free = 0x0ff57c25; 
define exported symbol mbedtls_blowfish_init = 0x0ff57c35; 
define exported symbol mbedtls_blowfish_setkey = 0x0ff57c41; 
define exported symbol mbedtls_calloc = 0x0ff57d29; 
define exported symbol mbedtls_camellia_crypt_cbc = 0x0ff57d3d; 
define exported symbol mbedtls_camellia_crypt_cfb128 = 0x0ff57ddd; 
define exported symbol mbedtls_camellia_crypt_ctr = 0x0ff57e69; 
define exported symbol mbedtls_camellia_crypt_ecb = 0x0ff57eed; 
define exported symbol mbedtls_camellia_free = 0x0ff58039; 
define exported symbol mbedtls_camellia_init = 0x0ff58049; 
define exported symbol mbedtls_camellia_setkey_dec = 0x0ff58055; 
define exported symbol mbedtls_camellia_setkey_enc = 0x0ff58109; 
define exported symbol mbedtls_ccm_auth_decrypt = 0x0ff584fd; 
define exported symbol mbedtls_ccm_encrypt_and_tag = 0x0ff58511; 
define exported symbol mbedtls_ccm_free = 0x0ff58525; 
define exported symbol mbedtls_ccm_init = 0x0ff58541; 
define exported symbol mbedtls_ccm_setkey = 0x0ff58549; 
define exported symbol mbedtls_ccm_star_auth_decrypt = 0x0ff58595; 
define exported symbol mbedtls_ccm_star_encrypt_and_tag = 0x0ff58605; 
define exported symbol mbedtls_cipher_auth_decrypt = 0x0ff58631; 
define exported symbol mbedtls_cipher_auth_encrypt = 0x0ff586b5; 
define exported symbol mbedtls_cipher_check_tag = 0x0ff5872d; 
define exported symbol mbedtls_cipher_crypt = 0x0ff58781; 
define exported symbol mbedtls_cipher_finish = 0x0ff587c5; 
define exported symbol mbedtls_cipher_free = 0x0ff588c9; 
define exported symbol mbedtls_cipher_info_from_string = 0x0ff58919; 
define exported symbol mbedtls_cipher_info_from_type = 0x0ff5895d; 
define exported symbol mbedtls_cipher_info_from_values = 0x0ff58989; 
define exported symbol mbedtls_cipher_init = 0x0ff589d5; 
define exported symbol mbedtls_cipher_list = 0x0ff589dd; 
define exported symbol mbedtls_cipher_reset = 0x0ff58a29; 
define exported symbol mbedtls_cipher_set_iv = 0x0ff58a41; 
define exported symbol mbedtls_cipher_set_padding_mode = 0x0ff58a85; 
define exported symbol mbedtls_cipher_setkey = 0x0ff58ac5; 
define exported symbol mbedtls_cipher_setup = 0x0ff58b21; 
define exported symbol mbedtls_cipher_update = 0x0ff58b61; 
define exported symbol mbedtls_cipher_update_ad = 0x0ff58da9; 
define exported symbol mbedtls_cipher_write_tag = 0x0ff58de9; 
define exported symbol mbedtls_ciphersuite_preference_init = 0x0ff58e1d; 
define exported symbol mbedtls_ctr_drbg_free = 0x0ff58e81; 
define exported symbol mbedtls_ctr_drbg_init = 0x0ff58ea1; 
define exported symbol mbedtls_ctr_drbg_random = 0x0ff58ea9; 
define exported symbol mbedtls_ctr_drbg_random_with_add = 0x0ff58ec1; 
define exported symbol mbedtls_ctr_drbg_reseed = 0x0ff58fa9; 
define exported symbol mbedtls_ctr_drbg_seed = 0x0ff59035; 
define exported symbol mbedtls_ctr_drbg_seed_entropy_len = 0x0ff5904d; 
define exported symbol mbedtls_ctr_drbg_set_entropy_len = 0x0ff590a5; 
define exported symbol mbedtls_ctr_drbg_set_prediction_resistance = 0x0ff590a9; 
define exported symbol mbedtls_ctr_drbg_set_reseed_interval = 0x0ff590ad; 
define exported symbol mbedtls_ctr_drbg_update = 0x0ff590b1; 
define exported symbol mbedtls_ctr_drbg_update_ret = 0x0ff590c1; 
define exported symbol mbedtls_des3_crypt_cbc = 0x0ff590f1; 
define exported symbol mbedtls_des3_crypt_ecb = 0x0ff59151; 
define exported symbol mbedtls_des3_free = 0x0ff5917d; 
define exported symbol mbedtls_des3_init = 0x0ff59189; 
define exported symbol mbedtls_des3_set2key_dec = 0x0ff59191; 
define exported symbol mbedtls_des3_set2key_enc = 0x0ff591b5; 
define exported symbol mbedtls_des3_set3key_dec = 0x0ff591d9; 
define exported symbol mbedtls_des3_set3key_enc = 0x0ff591ed; 
define exported symbol mbedtls_des_crypt_cbc = 0x0ff59201; 
define exported symbol mbedtls_des_crypt_ecb = 0x0ff59265; 
define exported symbol mbedtls_des_free = 0x0ff59291; 
define exported symbol mbedtls_des_init = 0x0ff5929d; 
define exported symbol mbedtls_des_key_set_parity = 0x0ff592a5; 
define exported symbol mbedtls_des_setkey_dec = 0x0ff592c1; 
define exported symbol mbedtls_des_setkey_enc = 0x0ff592d5; 
define exported symbol mbedtls_dhm_calc_secret = 0x0ff592e9; 
define exported symbol mbedtls_dhm_free = 0x0ff593e1; 
define exported symbol mbedtls_dhm_init = 0x0ff59445; 
define exported symbol mbedtls_dhm_make_params = 0x0ff5944d; 
define exported symbol mbedtls_dhm_make_public = 0x0ff59579; 
define exported symbol mbedtls_dhm_parse_dhm = 0x0ff59655; 
define exported symbol mbedtls_dhm_read_params = 0x0ff5977d; 
define exported symbol mbedtls_dhm_read_public = 0x0ff597d1; 
define exported symbol mbedtls_dhm_set_group = 0x0ff597f5; 
define exported symbol mbedtls_ecdh_calc_secret = 0x0ff59825; 
define exported symbol mbedtls_ecdh_compute_shared = 0x0ff59829; 
define exported symbol mbedtls_ecdh_free = 0x0ff5982d; 
define exported symbol mbedtls_ecdh_gen_public = 0x0ff59859; 
define exported symbol mbedtls_ecdh_get_params = 0x0ff5985d; 
define exported symbol mbedtls_ecdh_init = 0x0ff59881; 
define exported symbol mbedtls_ecdh_make_params = 0x0ff598a9; 
define exported symbol mbedtls_ecdh_make_public = 0x0ff598c9; 
define exported symbol mbedtls_ecdh_read_params = 0x0ff598e9; 
define exported symbol mbedtls_ecdh_read_public = 0x0ff5991d; 
define exported symbol mbedtls_ecdh_setup = 0x0ff59921; 
define exported symbol mbedtls_ecdsa_free = 0x0ff59925; 
define exported symbol mbedtls_ecdsa_from_keypair = 0x0ff59931; 
define exported symbol mbedtls_ecdsa_genkey = 0x0ff59971; 
define exported symbol mbedtls_ecdsa_init = 0x0ff5999d; 
define exported symbol mbedtls_ecdsa_read_signature = 0x0ff599a1; 
define exported symbol mbedtls_ecdsa_read_signature_restartable = 0x0ff599b5; 
define exported symbol mbedtls_ecdsa_sign = 0x0ff59a61; 
define exported symbol mbedtls_ecdsa_sign_det = 0x0ff59c85; 
define exported symbol mbedtls_ecdsa_verify = 0x0ff59c89; 
define exported symbol mbedtls_ecdsa_write_signature = 0x0ff59e19; 
define exported symbol mbedtls_ecdsa_write_signature_det = 0x0ff59e2d; 
define exported symbol mbedtls_ecdsa_write_signature_restartable = 0x0ff59e49; 
define exported symbol mbedtls_ecjpake_check = 0x0ff59ea5; 
define exported symbol mbedtls_ecjpake_derive_secret = 0x0ff59ec9; 
define exported symbol mbedtls_ecjpake_free = 0x0ff59fb5; 
define exported symbol mbedtls_ecjpake_init = 0x0ff5a011; 
define exported symbol mbedtls_ecjpake_read_round_one = 0x0ff5a069; 
define exported symbol mbedtls_ecjpake_read_round_two = 0x0ff5a0ad; 
define exported symbol mbedtls_ecjpake_setup = 0x0ff5a16d; 
define exported symbol mbedtls_ecjpake_write_round_one = 0x0ff5a1bd; 
define exported symbol mbedtls_ecjpake_write_round_two = 0x0ff5a221; 
define exported symbol mbedtls_ecp_check_privkey = 0x0ff5a361; 
define exported symbol mbedtls_ecp_check_pub_priv = 0x0ff5a3e5; 
define exported symbol mbedtls_ecp_check_pubkey = 0x0ff5a4a9; 
define exported symbol mbedtls_ecp_copy = 0x0ff5a4f1; 
define exported symbol mbedtls_ecp_curve_info_from_grp_id = 0x0ff5a521; 
define exported symbol mbedtls_ecp_curve_info_from_name = 0x0ff5a541; 
define exported symbol mbedtls_ecp_curve_info_from_tls_id = 0x0ff5a571; 
define exported symbol mbedtls_ecp_curve_list = 0x0ff5a591; 
define exported symbol mbedtls_ecp_curve_val_init = 0x0ff5a59d; 
define exported symbol mbedtls_ecp_gen_key = 0x0ff5a5dd; 
define exported symbol mbedtls_ecp_gen_keypair = 0x0ff5a60d; 
define exported symbol mbedtls_ecp_gen_keypair_base = 0x0ff5a62d; 
define exported symbol mbedtls_ecp_gen_privkey = 0x0ff5a65d; 
define exported symbol mbedtls_ecp_group_copy = 0x0ff5a78d; 
define exported symbol mbedtls_ecp_group_free = 0x0ff5a795; 
define exported symbol mbedtls_ecp_group_init = 0x0ff5a7fd; 
define exported symbol mbedtls_ecp_group_load = 0x0ff5a839; 
define exported symbol mbedtls_ecp_grp_id_list = 0x0ff5ac65; 
define exported symbol mbedtls_ecp_is_zero = 0x0ff5acb5; 
define exported symbol mbedtls_ecp_keypair_free = 0x0ff5acc9; 
define exported symbol mbedtls_ecp_keypair_init = 0x0ff5aced; 
define exported symbol mbedtls_ecp_mul = 0x0ff5ad09; 
define exported symbol mbedtls_ecp_mul_restartable = 0x0ff5ad1d; 
define exported symbol mbedtls_ecp_muladd = 0x0ff5ae19; 
define exported symbol mbedtls_ecp_muladd_restartable = 0x0ff5ae31; 
define exported symbol mbedtls_ecp_point_cmp = 0x0ff5aead; 
define exported symbol mbedtls_ecp_point_free = 0x0ff5aee5; 
define exported symbol mbedtls_ecp_point_init = 0x0ff5af09; 
define exported symbol mbedtls_ecp_point_read_binary = 0x0ff5af25; 
define exported symbol mbedtls_ecp_point_read_string = 0x0ff5afa1; 
define exported symbol mbedtls_ecp_point_write_binary = 0x0ff5afd1; 
define exported symbol mbedtls_ecp_set_zero = 0x0ff5b07d; 
define exported symbol mbedtls_ecp_tls_read_group = 0x0ff5b0a9; 
define exported symbol mbedtls_ecp_tls_read_group_id = 0x0ff5b0c9; 
define exported symbol mbedtls_ecp_tls_read_point = 0x0ff5b10d; 
define exported symbol mbedtls_ecp_tls_write_group = 0x0ff5b149; 
define exported symbol mbedtls_ecp_tls_write_point = 0x0ff5b181; 
define exported symbol mbedtls_entropy_add_source = 0x0ff5b1bd; 
define exported symbol mbedtls_entropy_free = 0x0ff5b1ed; 
define exported symbol mbedtls_entropy_func = 0x0ff5b211; 
define exported symbol mbedtls_entropy_gather = 0x0ff5b2fd; 
define exported symbol mbedtls_entropy_init = 0x0ff5b301; 
define exported symbol mbedtls_entropy_update_manual = 0x0ff5b341; 
define exported symbol mbedtls_free = 0x0ff5b34d; 
define exported symbol mbedtls_gcm_auth_decrypt = 0x0ff5b361; 
define exported symbol mbedtls_gcm_crypt_and_tag = 0x0ff5b3d5; 
define exported symbol mbedtls_gcm_finish = 0x0ff5b421; 
define exported symbol mbedtls_gcm_free = 0x0ff5b555; 
define exported symbol mbedtls_gcm_init = 0x0ff5b575; 
define exported symbol mbedtls_gcm_setkey = 0x0ff5b581; 
define exported symbol mbedtls_gcm_starts = 0x0ff5b5d5; 
define exported symbol mbedtls_gcm_update = 0x0ff5b719; 
define exported symbol mbedtls_hardware_poll = 0x0ff5b81d; 
define exported symbol mbedtls_hkdf = 0x0ff5b839; 
define exported symbol mbedtls_hkdf_expand = 0x0ff5b889; 
define exported symbol mbedtls_hkdf_extract = 0x0ff5b99d; 
define exported symbol mbedtls_hmac_drbg_free = 0x0ff5b9f1; 
define exported symbol mbedtls_hmac_drbg_init = 0x0ff5ba0d; 
define exported symbol mbedtls_hmac_drbg_random = 0x0ff5ba15; 
define exported symbol mbedtls_hmac_drbg_random_with_add = 0x0ff5ba2d; 
define exported symbol mbedtls_hmac_drbg_reseed = 0x0ff5bb05; 
define exported symbol mbedtls_hmac_drbg_seed = 0x0ff5bb8d; 
define exported symbol mbedtls_hmac_drbg_seed_buf = 0x0ff5bc09; 
define exported symbol mbedtls_hmac_drbg_set_entropy_len = 0x0ff5bc5d; 
define exported symbol mbedtls_hmac_drbg_set_prediction_resistance = 0x0ff5bc61; 
define exported symbol mbedtls_hmac_drbg_set_reseed_interval = 0x0ff5bc65; 
define exported symbol mbedtls_hmac_drbg_update = 0x0ff5bc69; 
define exported symbol mbedtls_hmac_drbg_update_ret = 0x0ff5bc6d; 
define exported symbol mbedtls_internal_md5_process = 0x0ff5be3d; 
define exported symbol mbedtls_internal_sha1_process = 0x0ff5c58d; 
define exported symbol mbedtls_internal_sha256_process = 0x0ff5d5d1; 
define exported symbol mbedtls_internal_sha512_process = 0x0ff5dd15; 
define exported symbol mbedtls_md = 0x0ff5e699; 
define exported symbol mbedtls_md5 = 0x0ff5e6b5; 
define exported symbol mbedtls_md5_clone = 0x0ff5e6b9; 
define exported symbol mbedtls_md5_finish = 0x0ff5e6c1; 
define exported symbol mbedtls_md5_finish_ret = 0x0ff5e6c5; 
define exported symbol mbedtls_md5_free = 0x0ff5e795; 
define exported symbol mbedtls_md5_init = 0x0ff5e7a1; 
define exported symbol mbedtls_md5_process = 0x0ff5e7a9; 
define exported symbol mbedtls_md5_ret = 0x0ff5e7ad; 
define exported symbol mbedtls_md5_starts = 0x0ff5e7d1; 
define exported symbol mbedtls_md5_starts_ret = 0x0ff5e7d5; 
define exported symbol mbedtls_md5_update = 0x0ff5e811; 
define exported symbol mbedtls_md5_update_ret = 0x0ff5e815; 
define exported symbol mbedtls_md_clone = 0x0ff5e8b5; 
define exported symbol mbedtls_md_finish = 0x0ff5e8f1; 
define exported symbol mbedtls_md_free = 0x0ff5e909; 
define exported symbol mbedtls_md_get_name = 0x0ff5e941; 
define exported symbol mbedtls_md_get_size = 0x0ff5e94d; 
define exported symbol mbedtls_md_get_type = 0x0ff5e959; 
define exported symbol mbedtls_md_hmac = 0x0ff5e965; 
define exported symbol mbedtls_md_hmac_finish = 0x0ff5e9cd; 
define exported symbol mbedtls_md_hmac_reset = 0x0ff5ea29; 
define exported symbol mbedtls_md_hmac_starts = 0x0ff5ea61; 
define exported symbol mbedtls_md_hmac_update = 0x0ff5eb2d; 
define exported symbol mbedtls_md_info_from_string = 0x0ff5eb51; 
define exported symbol mbedtls_md_info_from_type = 0x0ff5ec0d; 
define exported symbol mbedtls_md_init = 0x0ff5ec25; 
define exported symbol mbedtls_md_init_ctx = 0x0ff5ec2d; 
define exported symbol mbedtls_md_list = 0x0ff5ec35; 
define exported symbol mbedtls_md_process = 0x0ff5ec41; 
define exported symbol mbedtls_md_setup = 0x0ff5ec59; 
define exported symbol mbedtls_md_starts = 0x0ff5eca9; 
define exported symbol mbedtls_md_update = 0x0ff5ecc1; 
define exported symbol mbedtls_memory_buffer_alloc_free = 0x0ff5ecd9; 
define exported symbol mbedtls_memory_buffer_alloc_init = 0x0ff5ece9; 
define exported symbol mbedtls_memory_buffer_alloc_verify = 0x0ff5ed59; 
define exported symbol mbedtls_memory_buffer_set_verify = 0x0ff5ed5d; 
define exported symbol mbedtls_mpi_add_abs = 0x0ff5ed69; 
define exported symbol mbedtls_mpi_add_int = 0x0ff5ee39; 
define exported symbol mbedtls_mpi_add_mpi = 0x0ff5ee65; 
define exported symbol mbedtls_mpi_bitlen = 0x0ff5eebd; 
define exported symbol mbedtls_mpi_cmp_abs = 0x0ff5eef5; 
define exported symbol mbedtls_mpi_cmp_int = 0x0ff5ef85; 
define exported symbol mbedtls_mpi_cmp_mpi = 0x0ff5efad; 
define exported symbol mbedtls_mpi_copy = 0x0ff5f065; 
define exported symbol mbedtls_mpi_div_int = 0x0ff5f0d1; 
define exported symbol mbedtls_mpi_div_mpi = 0x0ff5f0fd; 
define exported symbol mbedtls_mpi_exp_mod = 0x0ff5f479; 
define exported symbol mbedtls_mpi_exp_mod_sw = 0x0ff5f581; 
define exported symbol mbedtls_mpi_fill_random = 0x0ff5fa19; 
define exported symbol mbedtls_mpi_free = 0x0ff5fa81; 
define exported symbol mbedtls_mpi_gcd = 0x0ff5faa9; 
define exported symbol mbedtls_mpi_gen_prime = 0x0ff5fbcd; 
define exported symbol mbedtls_mpi_get_bit = 0x0ff5fdc9; 
define exported symbol mbedtls_mpi_grow = 0x0ff5fde9; 
define exported symbol mbedtls_mpi_init = 0x0ff5fe41; 
define exported symbol mbedtls_mpi_inv_mod = 0x0ff5fe4d; 
define exported symbol mbedtls_mpi_is_prime = 0x0ff60125; 
define exported symbol mbedtls_mpi_is_prime_ext = 0x0ff60131; 
define exported symbol mbedtls_mpi_lsb = 0x0ff60191; 
define exported symbol mbedtls_mpi_lset = 0x0ff601d9; 
define exported symbol mbedtls_mpi_mod_int = 0x0ff60215; 
define exported symbol mbedtls_mpi_mod_mpi = 0x0ff602a9; 
define exported symbol mbedtls_mpi_mul_int = 0x0ff60321; 
define exported symbol mbedtls_mpi_mul_mpi = 0x0ff6033d; 
define exported symbol mbedtls_mpi_read_binary = 0x0ff604fd; 
define exported symbol mbedtls_mpi_read_string = 0x0ff6055d; 
define exported symbol mbedtls_mpi_safe_cond_assign = 0x0ff606bd; 
define exported symbol mbedtls_mpi_safe_cond_swap = 0x0ff60751; 
define exported symbol mbedtls_mpi_set_bit = 0x0ff607f9; 
define exported symbol mbedtls_mpi_shift_l = 0x0ff60855; 
define exported symbol mbedtls_mpi_shift_r = 0x0ff608f1; 
define exported symbol mbedtls_mpi_shrink = 0x0ff60979; 
define exported symbol mbedtls_mpi_size = 0x0ff609e9; 
define exported symbol mbedtls_mpi_sub_abs = 0x0ff609f5; 
define exported symbol mbedtls_mpi_sub_int = 0x0ff60a79; 
define exported symbol mbedtls_mpi_sub_mpi = 0x0ff60aa5; 
define exported symbol mbedtls_mpi_swap = 0x0ff60afd; 
define exported symbol mbedtls_mpi_write_binary = 0x0ff60b29; 
define exported symbol mbedtls_mpi_write_string = 0x0ff60bb1; 
define exported symbol mbedtls_oid_get_attr_short_name = 0x0ff60cd9; 
define exported symbol mbedtls_oid_get_cipher_alg = 0x0ff60cf1; 
define exported symbol mbedtls_oid_get_ec_grp = 0x0ff60d09; 
define exported symbol mbedtls_oid_get_extended_key_usage = 0x0ff60d21; 
define exported symbol mbedtls_oid_get_md_alg = 0x0ff60d39; 
define exported symbol mbedtls_oid_get_md_hmac = 0x0ff60d51; 
define exported symbol mbedtls_oid_get_numeric_string = 0x0ff60d69; 
define exported symbol mbedtls_oid_get_oid_by_ec_grp = 0x0ff60e35; 
define exported symbol mbedtls_oid_get_oid_by_md = 0x0ff60e79; 
define exported symbol mbedtls_oid_get_oid_by_pk_alg = 0x0ff60ebd; 
define exported symbol mbedtls_oid_get_oid_by_sig_alg = 0x0ff60f01; 
define exported symbol mbedtls_oid_get_pk_alg = 0x0ff60f4d; 
define exported symbol mbedtls_oid_get_pkcs12_pbe_alg = 0x0ff60f65; 
define exported symbol mbedtls_oid_get_sig_alg = 0x0ff60f85; 
define exported symbol mbedtls_oid_get_sig_alg_desc = 0x0ff60fa5; 
define exported symbol mbedtls_oid_get_x509_ext_type = 0x0ff60fbd; 
define exported symbol mbedtls_pem_free = 0x0ff60fd5; 
define exported symbol mbedtls_pem_init = 0x0ff60ffd; 
define exported symbol mbedtls_pem_read_buffer = 0x0ff61005; 
define exported symbol mbedtls_pem_write_buffer = 0x0ff613b1; 
define exported symbol mbedtls_pk_can_do = 0x0ff614b1; 
define exported symbol mbedtls_pk_check_pair = 0x0ff614c1; 
define exported symbol mbedtls_pk_debug = 0x0ff61515; 
define exported symbol mbedtls_pk_decrypt = 0x0ff61541; 
define exported symbol mbedtls_pk_encrypt = 0x0ff61581; 
define exported symbol mbedtls_pk_free = 0x0ff615b5; 
define exported symbol mbedtls_pk_get_bitlen = 0x0ff615d5; 
define exported symbol mbedtls_pk_get_name = 0x0ff615f1; 
define exported symbol mbedtls_pk_get_type = 0x0ff61609; 
define exported symbol mbedtls_pk_info_from_type = 0x0ff61619; 
define exported symbol mbedtls_pk_init = 0x0ff61631; 
define exported symbol mbedtls_pk_parse_key = 0x0ff61639; 
define exported symbol mbedtls_pk_parse_public_key = 0x0ff61989; 
define exported symbol mbedtls_pk_parse_subpubkey = 0x0ff61b4d; 
define exported symbol mbedtls_pk_setup = 0x0ff61c69; 
define exported symbol mbedtls_pk_setup_rsa_alt = 0x0ff61c9d; 
define exported symbol mbedtls_pk_sign = 0x0ff61ced; 
define exported symbol mbedtls_pk_sign_restartable = 0x0ff61d09; 
define exported symbol mbedtls_pk_verify = 0x0ff61d55; 
define exported symbol mbedtls_pk_verify_ext = 0x0ff61d69; 
define exported symbol mbedtls_pk_verify_restartable = 0x0ff61e21; 
define exported symbol mbedtls_pk_write_key_der = 0x0ff61e6d; 
define exported symbol mbedtls_pk_write_key_pem = 0x0ff621a5; 
define exported symbol mbedtls_pk_write_pubkey = 0x0ff6229d; 
define exported symbol mbedtls_pk_write_pubkey_der = 0x0ff622f1; 
define exported symbol mbedtls_pk_write_pubkey_pem = 0x0ff623e1; 
define exported symbol mbedtls_pkcs12_derivation = 0x0ff62461; 
define exported symbol mbedtls_pkcs12_pbe = 0x0ff62675; 
define exported symbol mbedtls_pkcs12_pbe_sha1_rc4_128 = 0x0ff62751; 
define exported symbol mbedtls_pkcs5_pbes2 = 0x0ff627bd; 
define exported symbol mbedtls_pkcs5_pbkdf2_hmac = 0x0ff62939; 
define exported symbol mbedtls_platform_set_calloc_free = 0x0ff62a79; 
define exported symbol mbedtls_platform_set_hardware_poll = 0x0ff62a91; 
define exported symbol mbedtls_platform_set_printf = 0x0ff62aa1; 
define exported symbol mbedtls_platform_set_snprintf = 0x0ff62ab1; 
define exported symbol mbedtls_platform_set_time = 0x0ff62ac1; 
define exported symbol mbedtls_platform_setup = 0x0ff62ad1; 
define exported symbol mbedtls_platform_teardown = 0x0ff62ad5; 
define exported symbol mbedtls_platform_zeroize = 0x0ff62ad9; 
define exported symbol mbedtls_rsa_check_privkey = 0x0ff62ae1; 
define exported symbol mbedtls_rsa_check_pub_priv = 0x0ff62b59; 
define exported symbol mbedtls_rsa_check_pubkey = 0x0ff62b9d; 
define exported symbol mbedtls_rsa_complete = 0x0ff62bed; 
define exported symbol mbedtls_rsa_copy = 0x0ff62d75; 
define exported symbol mbedtls_rsa_deduce_crt = 0x0ff62e7d; 
define exported symbol mbedtls_rsa_deduce_primes = 0x0ff62efd; 
define exported symbol mbedtls_rsa_deduce_private_exponent = 0x0ff63125; 
define exported symbol mbedtls_rsa_export = 0x0ff631f9; 
define exported symbol mbedtls_rsa_export_crt = 0x0ff632cd; 
define exported symbol mbedtls_rsa_export_raw = 0x0ff6335d; 
define exported symbol mbedtls_rsa_free = 0x0ff63449; 
define exported symbol mbedtls_rsa_gen_key = 0x0ff634c1; 
define exported symbol mbedtls_rsa_get_len = 0x0ff63735; 
define exported symbol mbedtls_rsa_import = 0x0ff63739; 
define exported symbol mbedtls_rsa_import_raw = 0x0ff637a9; 
define exported symbol mbedtls_rsa_init = 0x0ff63829; 
define exported symbol mbedtls_rsa_pkcs1_decrypt = 0x0ff63849; 
define exported symbol mbedtls_rsa_pkcs1_encrypt = 0x0ff63889; 
define exported symbol mbedtls_rsa_pkcs1_sign = 0x0ff638c9; 
define exported symbol mbedtls_rsa_pkcs1_verify = 0x0ff638ed; 
define exported symbol mbedtls_rsa_private = 0x0ff63911; 
define exported symbol mbedtls_rsa_private_sw = 0x0ff639a9; 
define exported symbol mbedtls_rsa_public = 0x0ff63c59; 
define exported symbol mbedtls_rsa_rsaes_oaep_decrypt = 0x0ff63ce9; 
define exported symbol mbedtls_rsa_rsaes_oaep_encrypt = 0x0ff63e95; 
define exported symbol mbedtls_rsa_rsaes_pkcs1_v15_decrypt = 0x0ff63fd9; 
define exported symbol mbedtls_rsa_rsaes_pkcs1_v15_encrypt = 0x0ff641b9; 
define exported symbol mbedtls_rsa_rsassa_pkcs1_v15_sign = 0x0ff642a9; 
define exported symbol mbedtls_rsa_rsassa_pkcs1_v15_verify = 0x0ff64385; 
define exported symbol mbedtls_rsa_rsassa_pss_sign = 0x0ff6444d; 
define exported symbol mbedtls_rsa_rsassa_pss_verify = 0x0ff6460d; 
define exported symbol mbedtls_rsa_rsassa_pss_verify_ext = 0x0ff64639; 
define exported symbol mbedtls_rsa_set_padding = 0x0ff64831; 
define exported symbol mbedtls_rsa_validate_crt = 0x0ff64839; 
define exported symbol mbedtls_rsa_validate_params = 0x0ff64975; 
define exported symbol mbedtls_sha1 = 0x0ff64b8d; 
define exported symbol mbedtls_sha1_clone = 0x0ff64b91; 
define exported symbol mbedtls_sha1_finish = 0x0ff64b99; 
define exported symbol mbedtls_sha1_finish_ret = 0x0ff64b9d; 
define exported symbol mbedtls_sha1_free = 0x0ff64c81; 
define exported symbol mbedtls_sha1_init = 0x0ff64c8d; 
define exported symbol mbedtls_sha1_process = 0x0ff64c95; 
define exported symbol mbedtls_sha1_ret = 0x0ff64c99; 
define exported symbol mbedtls_sha1_starts = 0x0ff64cbd; 
define exported symbol mbedtls_sha1_starts_ret = 0x0ff64cc1; 
define exported symbol mbedtls_sha1_update = 0x0ff64d01; 
define exported symbol mbedtls_sha1_update_ret = 0x0ff64d05; 
define exported symbol mbedtls_sha256 = 0x0ff64da5; 
define exported symbol mbedtls_sha256_clone = 0x0ff64da9; 
define exported symbol mbedtls_sha256_finish = 0x0ff64db1; 
define exported symbol mbedtls_sha256_finish_ret = 0x0ff64db5; 
define exported symbol mbedtls_sha256_free = 0x0ff64ed9; 
define exported symbol mbedtls_sha256_init = 0x0ff64ee5; 
define exported symbol mbedtls_sha256_process = 0x0ff64eed; 
define exported symbol mbedtls_sha256_ret = 0x0ff64ef1; 
define exported symbol mbedtls_sha256_starts = 0x0ff64f21; 
define exported symbol mbedtls_sha256_starts_ret = 0x0ff64f25; 
define exported symbol mbedtls_sha256_update = 0x0ff64fdd; 
define exported symbol mbedtls_sha256_update_ret = 0x0ff64fe1; 
define exported symbol mbedtls_sha512 = 0x0ff65081; 
define exported symbol mbedtls_sha512_clone = 0x0ff65085; 
define exported symbol mbedtls_sha512_finish = 0x0ff6508d; 
define exported symbol mbedtls_sha512_finish_ret = 0x0ff65091; 
define exported symbol mbedtls_sha512_free = 0x0ff652fd; 
define exported symbol mbedtls_sha512_init = 0x0ff65309; 
define exported symbol mbedtls_sha512_process = 0x0ff65311; 
define exported symbol mbedtls_sha512_ret = 0x0ff65315; 
define exported symbol mbedtls_sha512_starts = 0x0ff65355; 
define exported symbol mbedtls_sha512_starts_ret = 0x0ff65359; 
define exported symbol mbedtls_sha512_update = 0x0ff654b9; 
define exported symbol mbedtls_sha512_update_ret = 0x0ff654bd; 
define exported symbol mbedtls_ssl_ciphersuite_from_id = 0x0ff65571; 
define exported symbol mbedtls_ssl_ciphersuite_from_string = 0x0ff65595; 
define exported symbol mbedtls_ssl_ciphersuite_uses_ec = 0x0ff655c5; 
define exported symbol mbedtls_ssl_ciphersuite_uses_psk = 0x0ff655fd; 
define exported symbol mbedtls_ssl_get_ciphersuite_id = 0x0ff6575d; 
define exported symbol mbedtls_ssl_get_ciphersuite_name = 0x0ff6576d; 
define exported symbol mbedtls_ssl_get_ciphersuite_sig_alg = 0x0ff65785; 
define exported symbol mbedtls_ssl_get_ciphersuite_sig_pk_alg = 0x0ff657a9; 
define exported symbol mbedtls_ssl_list_ciphersuites = 0x0ff657e5; 
define exported symbol mbedtls_strerror = 0x0ff65a75; 
define exported symbol mbedtls_time = 0x0ff65a81; 
define exported symbol mbedtls_x509_crl_free = 0x0ff65ac9; 
define exported symbol mbedtls_x509_crl_info = 0x0ff65b4d; 
define exported symbol mbedtls_x509_crl_init = 0x0ff65e75; 
define exported symbol mbedtls_x509_crl_parse = 0x0ff65e7d; 
define exported symbol mbedtls_x509_crl_parse_der = 0x0ff65f65; 
define exported symbol mbedtls_x509_crt_check_extended_key_usage = 0x0ff66259; 
define exported symbol mbedtls_x509_crt_check_key_usage = 0x0ff662bd; 
define exported symbol mbedtls_x509_crt_free = 0x0ff662f9; 
define exported symbol mbedtls_x509_crt_info = 0x0ff663c5; 
define exported symbol mbedtls_x509_crt_init = 0x0ff66889; 
define exported symbol mbedtls_x509_crt_is_revoked = 0x0ff66895; 
define exported symbol mbedtls_x509_crt_parse = 0x0ff668cd; 
define exported symbol mbedtls_x509_crt_parse_der = 0x0ff66a35; 
define exported symbol mbedtls_x509_crt_parse_der_nocopy = 0x0ff66ad1; 
define exported symbol mbedtls_x509_crt_verify = 0x0ff66ad9; 
define exported symbol mbedtls_x509_crt_verify_info = 0x0ff66af9; 
define exported symbol mbedtls_x509_crt_verify_restartable = 0x0ff66bd5; 
define exported symbol mbedtls_x509_crt_verify_with_profile = 0x0ff66c99; 
define exported symbol mbedtls_x509_csr_free = 0x0ff66cb5; 
define exported symbol mbedtls_x509_csr_info = 0x0ff66d05; 
define exported symbol mbedtls_x509_csr_init = 0x0ff66e5d; 
define exported symbol mbedtls_x509_csr_parse = 0x0ff66e65; 
define exported symbol mbedtls_x509_csr_parse_der = 0x0ff66f75; 
define exported symbol mbedtls_x509_dn_gets = 0x0ff67165; 
define exported symbol mbedtls_x509_get_alg = 0x0ff672b9; 
define exported symbol mbedtls_x509_get_alg_null = 0x0ff672c9; 
define exported symbol mbedtls_x509_get_ext = 0x0ff672d9; 
define exported symbol mbedtls_x509_get_name = 0x0ff67341; 
define exported symbol mbedtls_x509_get_rsassa_pss_params = 0x0ff673e5; 
define exported symbol mbedtls_x509_get_serial = 0x0ff67591; 
define exported symbol mbedtls_x509_get_sig = 0x0ff675e5; 
define exported symbol mbedtls_x509_get_sig_alg = 0x0ff6762d; 
define exported symbol mbedtls_x509_get_time = 0x0ff676c9; 
define exported symbol mbedtls_x509_key_size_helper = 0x0ff67721; 
define exported symbol mbedtls_x509_serial_gets = 0x0ff67761; 
define exported symbol mbedtls_x509_set_extension = 0x0ff67831; 
define exported symbol mbedtls_x509_sig_alg_gets = 0x0ff67869; 
define exported symbol mbedtls_x509_string_to_names = 0x0ff67955; 
define exported symbol mbedtls_x509_time_is_future = 0x0ff67a69; 
define exported symbol mbedtls_x509_time_is_past = 0x0ff67a6d; 
define exported symbol mbedtls_x509_write_extensions = 0x0ff67a71; 
define exported symbol mbedtls_x509_write_names = 0x0ff67aa5; 
define exported symbol mbedtls_x509_write_sig = 0x0ff67afd; 
define exported symbol mbedtls_x509write_crt_der = 0x0ff67b9d; 
define exported symbol mbedtls_x509write_crt_free = 0x0ff67ed1; 
define exported symbol mbedtls_x509write_crt_init = 0x0ff67f01; 
define exported symbol mbedtls_x509write_crt_pem = 0x0ff67f19; 
define exported symbol mbedtls_x509write_crt_set_authority_key_identifier = 0x0ff67fa9; 
define exported symbol mbedtls_x509write_crt_set_basic_constraints = 0x0ff6805d; 
define exported symbol mbedtls_x509write_crt_set_extension = 0x0ff68109; 
define exported symbol mbedtls_x509write_crt_set_issuer_key = 0x0ff68111; 
define exported symbol mbedtls_x509write_crt_set_issuer_name = 0x0ff68115; 
define exported symbol mbedtls_x509write_crt_set_key_usage = 0x0ff6811d; 
define exported symbol mbedtls_x509write_crt_set_md_alg = 0x0ff6818d; 
define exported symbol mbedtls_x509write_crt_set_ns_cert_type = 0x0ff68191; 
define exported symbol mbedtls_x509write_crt_set_serial = 0x0ff681dd; 
define exported symbol mbedtls_x509write_crt_set_subject_key = 0x0ff681e5; 
define exported symbol mbedtls_x509write_crt_set_subject_key_identifier = 0x0ff681e9; 
define exported symbol mbedtls_x509write_crt_set_subject_name = 0x0ff68279; 
define exported symbol mbedtls_x509write_crt_set_validity = 0x0ff68281; 
define exported symbol mbedtls_x509write_crt_set_version = 0x0ff682d1; 
define exported symbol mbedtls_x509write_csr_der = 0x0ff682d5; 
define exported symbol mbedtls_x509write_csr_free = 0x0ff68585; 
define exported symbol mbedtls_x509write_csr_init = 0x0ff685a5; 
define exported symbol mbedtls_x509write_csr_pem = 0x0ff685ad; 
define exported symbol mbedtls_x509write_csr_set_extension = 0x0ff6864d; 
define exported symbol mbedtls_x509write_csr_set_key = 0x0ff68669; 
define exported symbol mbedtls_x509write_csr_set_key_usage = 0x0ff6866d; 
define exported symbol mbedtls_x509write_csr_set_md_alg = 0x0ff686ad; 
define exported symbol mbedtls_x509write_csr_set_ns_cert_type = 0x0ff686b1; 
define exported symbol mbedtls_x509write_csr_set_subject_name = 0x0ff686f9; 
define exported symbol mbedtls_xtea_crypt_cbc = 0x0ff68701; 
define exported symbol mbedtls_xtea_crypt_ecb = 0x0ff687a5; 
define exported symbol mbedtls_xtea_free = 0x0ff68865; 
define exported symbol mbedtls_xtea_init = 0x0ff68871; 
define exported symbol mbedtls_xtea_setup = 0x0ff68879; 
define exported symbol x25519_ge_add = 0x0ff6b7f9; 
define exported symbol x25519_ge_frombytes_vartime = 0x0ff6b8a5; 
define exported symbol x25519_ge_p1p1_to_p2 = 0x0ff6b9d9; 
define exported symbol x25519_ge_p1p1_to_p3 = 0x0ff6ba09; 
define exported symbol x25519_ge_p3_to_cached = 0x0ff6ba4d; 
define exported symbol x25519_ge_sub = 0x0ff6ba89; 
define exported symbol x25519_ge_tobytes = 0x0ff6bb35; 
define exported symbol x25519_sc_reduce = 0x0ff6bb7d; 
define exported symbol ciphersuite_preference_default = 0x0ff726a8; 
define exported symbol mbedtls_cipher_definitions = 0x0ff72df0; 
define exported symbol mbedtls_ecdsa_info = 0x0ff72f88; 
define exported symbol mbedtls_eckey_info = 0x0ff72fb8; 
define exported symbol mbedtls_eckeydh_info = 0x0ff72fe8; 
define exported symbol mbedtls_ed25519_info = 0x0ff73018; 
define exported symbol mbedtls_md5_info = 0x0ff73048; 
define exported symbol mbedtls_rsa_alt_info = 0x0ff73078; 
define exported symbol mbedtls_rsa_info = 0x0ff730a8; 
define exported symbol mbedtls_sha1_info = 0x0ff730d8; 
define exported symbol mbedtls_sha224_info = 0x0ff73108; 
define exported symbol mbedtls_sha256_info = 0x0ff73138; 
define exported symbol mbedtls_sha384_info = 0x0ff73168; 
define exported symbol mbedtls_sha512_info = 0x0ff73198; 
define exported symbol mbedtls_x509_crt_profile_next = 0x0ff731d8; 
define exported symbol mbedtls_x509_crt_profile_suiteb = 0x0ff731e8; 
define exported symbol mbedtls_hwpka_flag_set = 0x0ff5bd45; 
define exported symbol ROM_CRYP_AES_ECB = 0x0ff77791; 
define exported symbol ROM_HMAC_SHA1 = 0x0ff79139; 
